## main/Kconfig.projbuild
```kconfig
#
#    Copyright (c) 2020 Project CHIP Authors
#    All rights reserved.
#
#    Licensed under the Apache License, Version 2.0 (the "License");
#    you may not use this file except in compliance with the License.
#    You may obtain a copy of the License at
#
#        http://www.apache.org/licenses/LICENSE-2.0
#
#    Unless required by applicable law or agreed to in writing, software
#    distributed under the License is distributed on an "AS IS" BASIS,
#    WITHOUT WARRANTIES OR CONDITIONS OF ANY KIND, either express or implied.
#    See the License for the specific language governing permissions and
#    limitations under the License.
#
#    Description:
#      Configuration options CHIP ESP32 demo application.
#

menu "TEEL Temperature 1"

    orsource "$IDF_PATH/examples/common_components/env_caps/$IDF_TARGET/Kconfig.env_caps"

    config I2C_MASTER_SCL
        int "SCL GPIO Num"
        range ENV_GPIO_RANGE_MIN ENV_GPIO_OUT_RANGE_MAX
        default 19 if IDF_TARGET_ESP32 || IDF_TARGET_ESP32S2 || IDF_TARGET_ESP32S3
        default 2
        help
            GPIO number for I2C Master clock line.

    config I2C_MASTER_SDA
        int "SDA GPIO Num"
        range ENV_GPIO_RANGE_MIN ENV_GPIO_OUT_RANGE_MAX
        default 18 if IDF_TARGET_ESP32 || IDF_TARGET_ESP32S2 || IDF_TARGET_ESP32S3
        default 1
        help
            GPIO number for I2C Master data line.

    choice
      prompt "Rendezvous Mode"
      default RENDEZVOUS_MODE_BLE
      help
          Specifies the Rendezvous mode of the peripheral.

      config RENDEZVOUS_MODE_WIFI
          bool "Wi-Fi"
      config RENDEZVOUS_MODE_BLE
          bool "BLE"
      config RENDEZVOUS_MODE_THREAD
          bool "Thread"
      config RENDEZVOUS_MODE_ETHERNET
          bool "Ethernet"
    endchoice

    config RENDEZVOUS_MODE
       int
       range 0 8
       default 1 if RENDEZVOUS_MODE_WIFI
       default 2 if RENDEZVOUS_MODE_BLE
       default 4 if RENDEZVOUS_MODE_THREAD
       default 8 if RENDEZVOUS_MODE_ETHERNET

endmenu
```
